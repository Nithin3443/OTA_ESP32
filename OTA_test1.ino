#include <WiFi.h>
#include <WiFiClientSecure.h>
#include <HTTPClient.h>
#include <Update.h>
#include <esp_ota_ops.h>
#include <esp_partition.h>

#define FW_VERSION "1.0.0"

const char* WIFI_SSID = "WiFi-13AFE0";
const char* WIFI_PASSWORD = "Chaprasi1";

// Google root CA certificate
const char* ROOT_CA = R"EOF(
-----BEGIN CERTIFICATE-----
MIIDdzCCAl+gAwIBAgIEAgAAuTANBgkqhkiG9w0BAQsFADBaMQswCQYDVQQGEwJV
UzELMAkGA1UECBMCQ0ExFDASBgNVBAoTC0dvb2dsZSBJbmMuMRQwEgYDVQQDEwtH
b29nbGUgUm9vdCBDQTAeFw0xMDAyMDEwMDAwMDBaFw0zMDAyMDEwMDAwMDBaMFox
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Y5Q7X9Q7V4Y5Q8X7Q4V5Y7Q9V4X5Q7Y9V4Y5Q7X9Q7V4Y5Q8X7Q4V5
-----END CERTIFICATE-----
)EOF";



void setup() {

  Serial.begin(115200);

  delay(1000);

  Serial.println();
  Serial.println("================================");
  Serial.println("ESP32-C3 OTA PROJECT");
  Serial.println("================================");

  Serial.print("Firmware version: ");
  Serial.println(FW_VERSION);

  connectWiFi();
  testHTTPSConnection();
  printOTAInfo();
}


void loop() {

  delay(1000);

}


void connectWiFi() {

  Serial.println();
  Serial.println("Connecting to Wi-Fi...");

  WiFi.mode(WIFI_STA);

  WiFi.begin(WIFI_SSID, WIFI_PASSWORD);

  int attempts = 0;

  while (WiFi.status() != WL_CONNECTED) {

    delay(500);

    Serial.print(".");

    attempts++;

    if (attempts >= 40) {

      Serial.println();
      Serial.println("Wi-Fi connection failed.");

      return;
    }
  }

  Serial.println();
  Serial.println("Wi-Fi connected.");

  Serial.print("IP address: ");
  Serial.println(WiFi.localIP());
}


void printOTAInfo() {

  const esp_partition_t *running =
      esp_ota_get_running_partition();

  const esp_partition_t *next =
      esp_ota_get_next_update_partition(NULL);

  Serial.println();
  Serial.println("========== OTA INFO ==========");

  if (running != NULL) {
    Serial.printf("Running partition: %s\n", running->label);
    Serial.printf("Running address: 0x%08X\n", running->address);
    Serial.printf("Running size: %u bytes\n", running->size);
  } else {
    Serial.println("Running partition: ERROR");
  }

  if (next != NULL) {
    Serial.printf("Next OTA partition: %s\n", next->label);
    Serial.printf("Next address: 0x%08X\n", next->address);
    Serial.printf("Next size: %u bytes\n", next->size);
  } else {
    Serial.println("Next OTA partition: ERROR");
  }

  Serial.println("==============================");
}
void testHTTPSConnection() {

  Serial.println();
  Serial.println("========== HTTPS TEST ==========");

  WiFiClientSecure client;

  // TEMPORARY ONLY
  // We will replace this with certificate validation later.
  client.setInsecure();

  if (client.connect("example.com", 443)) {
    Serial.println("HTTPS connection successful!");

    client.println("GET / HTTP/1.1");
    client.println("Host: example.com");
    client.println("Connection: close");
    client.println();

    unsigned long timeout = millis();

    while (client.connected() && millis() - timeout < 5000) {

      while (client.available()) {
        String line = client.readStringUntil('\n');
        Serial.println(line);

        timeout = millis();
      }
    }

    client.stop();

  } else {

    Serial.println("HTTPS connection FAILED");
  }

  Serial.println("================================");
}